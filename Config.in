## Config.in
```kconfig
source "$BR2_EXTERNAL_LIMA_PATH/package/mesa-lima/Config.in"
source "$BR2_EXTERNAL_LIMA_PATH/package/gfx/Config.in"
source "$BR2_EXTERNAL_LIMA_PATH/package/mesa-test-programs/Config.in"
```

## configs/lima_bananapi_m1_plus_defconfig
```kconfig
BR2_arm=y
BR2_cortex_a7=y
BR2_ARM_FPU_VFPV4=y
BR2_CCACHE=y
BR2_TOOLCHAIN_EXTERNAL=y
BR2_TARGET_GENERIC_HOSTNAME="bananapi-m1-plus"
BR2_TARGET_GENERIC_ISSUE="bananapi-m1-plus-lima"
BR2_ROOTFS_DEVICE_CREATION_DYNAMIC_EUDEV=y
BR2_TARGET_GENERIC_ROOT_PASSWD="root"
BR2_TARGET_GENERIC_GETTY_PORT="ttyS0"
BR2_SYSTEM_DHCP="eth0"
BR2_ROOTFS_POST_BUILD_SCRIPT="$(BR2_EXTERNAL_LIMA_PATH)/board/lima/post-build-getty-tty1.sh"
BR2_ROOTFS_POST_IMAGE_SCRIPT="support/scripts/genimage.sh"
BR2_ROOTFS_POST_SCRIPT_ARGS="-c $(BR2_EXTERNAL_LIMA_PATH)/board/lima/genimage-bananapi-m1-plus.cfg"
BR2_LINUX_KERNEL=y
BR2_LINUX_KERNEL_USE_CUSTOM_CONFIG=y
BR2_LINUX_KERNEL_CUSTOM_CONFIG_FILE="$(BR2_EXTERNAL_LIMA_PATH)/board/lima/linux-lima.config"
BR2_LINUX_KERNEL_DTS_SUPPORT=y
BR2_LINUX_KERNEL_INTREE_DTS_NAME="sun7i-a20-bananapi-m1-plus"
BR2_PACKAGE_STRACE=y
BR2_PACKAGE_KMSCUBE=y
BR2_PACKAGE_MESA3D_DEMOS=y
BR2_PACKAGE_MESA3D=y
BR2_PACKAGE_MESA3D_OSMESA=y
BR2_PACKAGE_MESA3D_OPENGL_EGL=y
BR2_PACKAGE_MESA3D_OPENGL_ES=y
BR2_PACKAGE_MESA3D_OPENGL_TEXTURE_FLOAT=y
BR2_PACKAGE_XORG7=y
BR2_PACKAGE_USBUTILS=y
BR2_PACKAGE_OPENSSL=y
BR2_PACKAGE_LIBEPOXY=y
BR2_PACKAGE_TIFF_UTILITIES=y
BR2_PACKAGE_NCURSES=y
BR2_PACKAGE_DROPBEAR=y
BR2_PACKAGE_FILE=y
BR2_TARGET_ROOTFS_EXT2=y
BR2_TARGET_ROOTFS_EXT2_4=y
BR2_TARGET_ROOTFS_EXT2_SIZE="100M"
BR2_TARGET_UBOOT=y
BR2_TARGET_UBOOT_BUILD_SYSTEM_KCONFIG=y
BR2_TARGET_UBOOT_CUSTOM_VERSION=y
BR2_TARGET_UBOOT_CUSTOM_VERSION_VALUE="2017.11"
BR2_TARGET_UBOOT_BOARD_DEFCONFIG="Bananapi"
BR2_TARGET_UBOOT_NEEDS_DTC=y
BR2_TARGET_UBOOT_SPL=y
BR2_TARGET_UBOOT_SPL_NAME="u-boot-sunxi-with-spl.bin"
BR2_TARGET_UBOOT_BOOT_SCRIPT=y
BR2_TARGET_UBOOT_BOOT_SCRIPT_SOURCE="$(BR2_EXTERNAL_LIMA_PATH)/board/lima/boot-bananapi-m1-plus.cmd"
BR2_PACKAGE_HOST_DOSFSTOOLS=y
BR2_PACKAGE_HOST_GENIMAGE=y
BR2_PACKAGE_HOST_MTOOLS=y
BR2_PACKAGE_MESA3D_GALLIUM_DRIVER_LIMA=y
BR2_PACKAGE_GFX=y
BR2_PACKAGE_MESA_TEST_PROGRAMS=y
```

## package/gfx/Config.in
```kconfig
config BR2_PACKAGE_GFX
	bool "gfx"
	depends on BR2_PACKAGE_LIBDRM
	depends on BR2_PACKAGE_MESA3D_OPENGL_EGL
	depends on BR2_PACKAGE_MESA3D_OPENGL_ES
	select BR2_PACKAGE_LIBPNG
	help
	  gfx programs
```

## package/mesa-lima/Config.in
```kconfig
# NOTE: this is a hack. See mesa-lima.mk for more details.

if BR2_PACKAGE_MESA3D

config BR2_PACKAGE_MESA3D_GALLIUM_DRIVER_LIMA
	bool "mesa3d lima driver"
	depends on BR2_arm || BR2_aarch64
	select BR2_PACKAGE_MESA3D_DRI_DRIVER
	select BR2_PACKAGE_MESA3D_GALLIUM_DRIVER
	help
	  OpenGL driver for ARM Mali400

endif # BR2_PACKAGE_MESA3D
```

## package/mesa-test-programs/Config.in
```kconfig
config BR2_PACKAGE_MESA_TEST_PROGRAMS
	bool "mesa-test-programs"
	depends on BR2_PACKAGE_LIBDRM
	depends on BR2_PACKAGE_MESA3D_OPENGL_EGL
	depends on BR2_PACKAGE_MESA3D_OPENGL_ES
	select BR2_PACKAGE_TIFF
	help
	  mesa-test-programs
```
